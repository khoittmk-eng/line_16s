#include "board.h"
#include "oled.h"
#include "timebase.h"
static uint8_t buffer[1024];
static uint32_t transaction_start;
static uint8_t online;
/* Glyph bytes retained from the owner's previous working OLED driver. */
static const uint8_t Font5x7[][5] = {
    {0x00, 0x00, 0x00, 0x00, 0x00},
    {0x00, 0x00, 0x5F, 0x00, 0x00},
    {0x00, 0x07, 0x00, 0x07, 0x00},
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    {0x44, 0x64, 0x54, 0x4C, 0x44}
};
static uint8_t Expired(void)
{
    return (uint32_t)(Time_Cycles() - transaction_start) > (SystemCoreClock / 1000U) * 6U;
}
static uint8_t Event(uint32_t event)
{
    while (!I2C_CheckEvent(I2C1, event)) {
        if (I2C1->SR1 & (I2C_SR1_AF | I2C_SR1_BERR | I2C_SR1_ARLO | I2C_SR1_OVR)) return 0;
        if (Expired()) return 0;
    }
    return 1;
}
static uint8_t Fail(void)
{
    I2C_GenerateSTOP(I2C1, ENABLE);
    I2C_Cmd(I2C1, DISABLE);
    online = 0;
    return 0;
}
static uint8_t Send(uint8_t control, const uint8_t *data, uint16_t count)
{
    uint16_t i;
    if (!online) return 0;
    transaction_start = Time_Cycles();
    while (I2C_GetFlagStatus(I2C1, I2C_FLAG_BUSY)) { if (Expired()) return Fail(); }
    I2C_GenerateSTART(I2C1, ENABLE);
    if (!Event(I2C_EVENT_MASTER_MODE_SELECT)) return Fail();
    /* SPL expects the address shifted left by one; 0x3C becomes legacy 0x78. */
    I2C_Send7bitAddress(I2C1, BOARD_OLED_ADDRESS_7BIT << 1U, I2C_Direction_Transmitter);
    if (!Event(I2C_EVENT_MASTER_TRANSMITTER_MODE_SELECTED)) return Fail();
    I2C_SendData(I2C1, control);
    if (!Event(I2C_EVENT_MASTER_BYTE_TRANSMITTED)) return Fail();
    for (i = 0; i < count; ++i) {
        I2C_SendData(I2C1, data[i]);
        if (!Event(I2C_EVENT_MASTER_BYTE_TRANSMITTED)) return Fail();
    }
    I2C_GenerateSTOP(I2C1, ENABLE);
    return 1;
}
uint8_t OLED_Init(void)
{
    GPIO_InitTypeDef gpio;
    I2C_InitTypeDef i2c;
    /* Same legacy initialization as the previous working project. */
    static const uint8_t legacy[] = {
        0xAE,0xD5,0x80,0xA8,0x3F,0xD3,0x00,0x40,0xAD,0x8B,0x33,
        0xA1,0xC8,0xDA,0x12,0x81,0xBF,0xD9,0x22,0xDB,0x40,0xA4,0xA6,0xAF
    };
    static const uint8_t ssd1306[] = {
        0xAE,0xD5,0x80,0xA8,0x3F,0xD3,0x00,0x40,0x8D,0x14,0x20,0x02,
        0xA1,0xC8,0xDA,0x12,0x81,0xBF,0xD9,0xF1,0xDB,0x40,0xA4,0xA6,0xAF
    };
    RCC_APB2PeriphClockCmd(RCC_APB2Periph_GPIOB | RCC_APB2Periph_AFIO, ENABLE);
    RCC_APB1PeriphClockCmd(RCC_APB1Periph_I2C1, ENABLE);
    GPIO_PinRemapConfig(GPIO_Remap_I2C1, ENABLE);
    GPIO_StructInit(&gpio);
    gpio.GPIO_Pin = GPIO_Pin_8 | GPIO_Pin_9;
    gpio.GPIO_Mode = GPIO_Mode_AF_OD;
    gpio.GPIO_Speed = GPIO_Speed_50MHz;
    GPIO_Init(GPIOB, &gpio);
    I2C_DeInit(I2C1);
    I2C_StructInit(&i2c);
    i2c.I2C_ClockSpeed = BOARD_OLED_I2C_HZ;
    I2C_Init(I2C1, &i2c);
    I2C_Cmd(I2C1, ENABLE);
    OLED_Clear();
    online = 1;
    return BOARD_OLED_LEGACY_INIT ? Send(0x00, legacy, sizeof(legacy)) :
                                   Send(0x00, ssd1306, sizeof(ssd1306));
}
void OLED_Clear(void)
{
    uint16_t i;
    for (i = 0; i < sizeof(buffer); ++i) buffer[i] = 0;
}
void OLED_Text(uint8_t row, const char *text)
{
    uint8_t col = 0, j;
    uint16_t offset;
    if (row >= 8U) return;
    offset = row * 128U;
    for (j = 0; j < 128U; ++j) buffer[offset + j] = 0;
    while (*text && col < 21U) {
        uint8_t c = (uint8_t)*text++;
        if (c < 32U || c > 122U) c = '?';
        for (j = 0; j < 5U; ++j) buffer[offset + col * 6U + j] = Font5x7[c - 32U][j];
        ++col;
    }
}
uint8_t OLED_FlushPage(uint8_t page)
{
    uint8_t cmd[3];
    if (page >= 8U) return 0;
    cmd[0] = 0xB0U + page;
    cmd[1] = BOARD_OLED_COLUMN_OFFSET & 0x0FU;
    cmd[2] = 0x10U | (BOARD_OLED_COLUMN_OFFSET >> 4U);
    if (!Send(0x00, cmd, sizeof(cmd))) return 0;
    return Send(0x40, &buffer[page * 128U], 128U);
}

void OLED_DrawPixel(uint8_t x, uint8_t y, uint8_t color)
{
    if (x >= 128U || y >= 64U) return;
    if (color) buffer[x + (y / 8U) * 128U] |= (uint8_t)(1U << (y & 7U));
    else buffer[x + (y / 8U) * 128U] &= (uint8_t)~(1U << (y & 7U));
}
void OLED_DrawString(uint8_t x, uint8_t y, const char *text, uint8_t color)
{
    while (*text && x <= 122U) {
        uint8_t c = (uint8_t)*text++, col, row;
        if (c < 32U || c > 122U) c = '?';
        for (col = 0; col < 5U; ++col)
            for (row = 0; row < 7U; ++row)
                OLED_DrawPixel(x + col, y + row,
                    (Font5x7[c - 32U][col] & (1U << row)) ? color : !color);
        x += 6U;
    }
}
void OLED_DrawRect(uint8_t x, uint8_t y, uint8_t width, uint8_t height, uint8_t color)
{
    uint16_t i;
    if (!width || !height) return;
    for (i = 0; i < width; ++i) {
        if ((uint16_t)x + i < 128U) {
            OLED_DrawPixel(x + i, y, color);
            if ((uint16_t)y + height - 1U < 64U) OLED_DrawPixel(x + i, y + height - 1U, color);
        }
    }
    for (i = 0; i < height; ++i) {
        if ((uint16_t)y + i < 64U) {
            OLED_DrawPixel(x, y + i, color);
            if ((uint16_t)x + width - 1U < 128U) OLED_DrawPixel(x + width - 1U, y + i, color);
        }
    }
}
